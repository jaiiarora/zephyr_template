## boards/arm/samsung_board/Kconfig.board
```kconfig
#
# Copyright (c) 2021, Samsung
#
# SPDX-License-Identifier: Apache-2.0
#

#The main Kconfig file for the board directory

config BOARD_SAMSUNG
  bool "Samsung Board"
  depends on SOC_SERIES_SM
  select SOC_PART_NUMBER_
  #CONFIGURE THE PART NUMBERS
```

## boards/arm/samsung_board/Kconfig.defconfig
```kconfig
#
# Copyright (c) 2021, Samsung
#
# SPDX-License-Identifier: Apache-2.0
#

# This file contains invisible symbols that select hardware interfaces and sets its default values

if BOARD_SAMSUNG

config BOARD
      default samsung_board

endif #BOARD_SAMSUNG
```

## soc/arm/samsung/Kconfig
```kconfig
#
# Copyright (c) 2021, SAMSUG
#
# SPDX-License-Identifier: Apache-2.0
#

config SOC_FAMILY_SAMSUNG
  bool
  # omit prompt to signify a "hidden" option
  default n

if SOC_FAMILY_SAMSUNG
config SOC_FAMILY
  string
  default "samsung_soc"
endif

source "soc/arm/samsung/*/Kconfig.soc"
```

## soc/arm/samsung/Kconfig.soc
```kconfig
#
# Copyright (c) 2021, SAMSUNG
#
# SPDX-License-Identifier: Apache-2.0
#

source "soc/arm/samsung/*/Kconfig.series"
```

## soc/arm/samsung/sm/Kconfig.defconfig.series
```kconfig
# Kconfig - SM Series
#
# Copyright (c) 2021, SAMSUNG
#
# SPDX-License-Identifier: Apache-2.0
#

if SOC_SERIES_SM

config SOC_SERIES
	default "sm"

config NUM_IRQS
	int
	# must be >= the highest interrupt number used
	default 160

source "soc/arm/samsung/sm/Kconfig.defconfig.sm*"

endif # SOC_SERIES_SM
```

## soc/arm/samsung/sm/Kconfig.series
```kconfig
# Kconfig - SM series
#
# Copyright (c) 2021, SAMSUNG
#
# SPDX-License-Identifier: Apache-2.0
#

#The Kconfig file for System on Chip  series
#Select all the configuration options here

config SOC_SERIES_SM
	bool "Sm Series"
	select CPU_CORTEX_M
	select CPU_CORTEX_M0
	select SOC_FAMILY_SAMSUNG
	select SYS_POWER_LOW_POWER_STATE_SUPPORTED
	select CPU_HAS_SYSTICK
	select CLOCK_CONTROL
	help
	  Enable support for SM series
```

## soc/arm/samsung/sm/Kconfig.soc
```kconfig
#
# Copyright (c) 2021, Samsung
#
# SPDX-License-Identifier: Apache-2.0
#

# The main Kconfig fle for the System on Chip
# A config option needs to be created for  the SOC part number here.
# The SOC_PART_NUMBER needs to  be a hidden option that should not be set directly


choice
prompt "Samsung SOC Series Selection"
depends on SOC_SERIES_SM

config SOC_SM1052
	bool "SOC_SM1052"
	select HAS_MCUX
	select HAS_MCUX_CCM
	select HAS_MCUX_IGPIO
	select HAS_MCUX_LPUART
	select CPU_HAS_FPU

endchoice
```
